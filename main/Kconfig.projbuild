## main/Kconfig.projbuild
```kconfig
menu "Example Configuration"

    config WIFI_SSID
        string "WiFi SSID"
        default "myssid"
        help
            SSID (network name) for the App to connect to.

    config WIFI_PASSWORD
        string "WiFi Password"
        default "mypassword"
        help
            WiFi password (WPA or WPA2) for the App to use.

    config BROKER_URI
        string "Broker URL"
        default "mqtts://iot.eclipse.org:8883"
        help
            URL of an mqtt broker which this example connects to.

    config BROKER_USERNAME
        string "Broker Username"
        default "user"
        help
            Username of the mqtt broker which this App connects to.

    config BROKER_PASSWORD
        string "Broker Password"
        default "password"
        help
            Password of the mqtt broker which this App connects to.

    config UPDATE_JSON_URL
        string "Update JSON URL"
        default ""
        help
            URL of JSON file with information on the latest firmware

    config OTA_UPDATE_ACTIVATED
        bool
        default y if UPDATE_JSON_URL != ""

endmenu
```
